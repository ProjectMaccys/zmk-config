#include <behaviors.dtsi>
#include <dt-bindings/zmk/keys.h>
#include <dt-bindings/zmk/bt.h>

/ {
    keymap {
        compatible = "zmk,keymap";

        default_layer{
            bindings = <
                &kp Q     &kp W     &kp E   &kp R   &kp T   &kp Y

            >;
        };

        bt_layer {
            bindings = <
                &s
            >;
        };
    };
};